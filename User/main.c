#include "stm32f10x.h"                  // Device header
#include "OLED.h"
#include <math.h>

#include "Camera_API.h"

#include "CeruleanBird.h"

#include "TextureMapper_API.h"

#include "bit_operate.h"

#include "WorldMap_API.h"

#include "Camera_internal.h"


volatile uint32_t frame_count = 0;
volatile uint32_t fps = 0;

void TIM2_IRQHandler(void) {
    if (TIM_GetITStatus(TIM2, TIM_IT_Update) != RESET) {
        TIM_ClearITPendingBit(TIM2, TIM_IT_Update);
        fps = frame_count;
        frame_count = 0;
    }
}

void init_timer(void) {
    RCC_APB1PeriphClockCmd(RCC_APB1Periph_TIM2, ENABLE);

    TIM_TimeBaseInitTypeDef timerInitStructure;
    timerInitStructure.TIM_Prescaler = 7200 - 1;  // 10 kHz
    timerInitStructure.TIM_CounterMode = TIM_CounterMode_Up;
    timerInitStructure.TIM_Period = 10000 - 1;  // 1 second
    timerInitStructure.TIM_ClockDivision = TIM_CKD_DIV1;
    TIM_TimeBaseInit(TIM2, &timerInitStructure);
    TIM_ITConfig(TIM2, TIM_IT_Update, ENABLE);
    TIM_Cmd(TIM2, ENABLE);

    NVIC_InitTypeDef nvicStructure;
    nvicStructure.NVIC_IRQChannel = TIM2_IRQn;
    nvicStructure.NVIC_IRQChannelPreemptionPriority = 0;
    nvicStructure.NVIC_IRQChannelSubPriority = 1;
    nvicStructure.NVIC_IRQChannelCmd = ENABLE;
    NVIC_Init(&nvicStructure);
}

void frame_capture(void) {
    frame_count++;
}

//测试地图
unsigned char TestMap2[] =
{
  1,1,1,1,1,1,1,1,1,1,1,1,1,1,1,1,1,1,1,1,1,1,1,1,
  1,0,0,0,0,0,0,0,0,0,0,0,0,0,0,0,0,0,0,0,0,0,0,1,
  1,0,0,0,0,0,0,0,0,0,0,0,0,0,0,0,0,0,0,0,0,0,0,1,
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  1,1,1,1,1,1,1,1,1,1,1,1,1,1,1,1,1,1,1,1,1,1,1,1
};

unsigned char kun2[]={
	
0xFF,0xFF,0xFF,0xFF,0xFF,0xFF,0xFF,0xFF,0xFF,0xFF,0xFF,0xFF,0xFF,0xFF,0xFF,0xFF,
0x3F,0x1F,0x0F,0x07,0x03,0x03,0x01,0x03,0x83,0x83,0x81,0x01,0x03,0x07,0x07,0x07,
0x0F,0x17,0x2F,0x3F,0x7F,0x7F,0xFF,0xFF,0xFF,0xFF,0xFF,0xFF,0xFF,0xFF,0xFF,0xFF,
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0x00,0x00,0x01,0x00,0x00,0x00,0x00,0x03,0x03,0x02,0x00,0x00,0x00,0x07,0x03,0x03
	
};





int main(){

	OLED_Init();
	SystemInit();
    init_timer();
	
	Camera_InitTypeDef camera_sturct;
	camera_sturct.direction.x = -1;
	camera_sturct.direction.y = 0;
	camera_sturct.FOV = 66;
	camera_sturct.moveSpeed = 0.01;
	camera_sturct.rotSpeed = 0.01 * 3.0;
	camera_sturct.position.x = 10;
	camera_sturct.position.y = 12;
	
	Camera_Struct* camera;
	
	//画布重定向
	Canvas_SetCanvasModeToRedirect(GetBufferAPI());
	
	//初始化
	CeruleanBird_Init(&camera, &camera_sturct);
	
	//添加纹理
	Texture_Add(1,kun2,48,48,BIT_TEXTURE);
	Texture_Add(2,kun2,48,48,BIT_TEXTURE);
	Texture_Add(3,kun2,48,48,BIT_TEXTURE);
	Texture_Add(4,kun2,48,48,BIT_TEXTURE);
	//添加地图
	WorldMap_Add(1,TestMap2,24,24);

		
	while(1){

		
	
		
		//地面打印
		for(int i = 32;i<64;i++){
			for(int j = 0;j<128;j++){
				//双数列
				if(j%2 == 0){
					if(i%2 == 0){//双数行打印
						Pixel_Operate(i,j,OPEN);
					}
				}
				
				//单数列
				else{
					if(i%2 != 0){//单数行打印
						Pixel_Operate(i,j,OPEN);
					}
					
				}

			}
		}
	
		
		Camera_Render(camera);		
		frame_capture();
		Hj_String(0,0,"FPS:");
		Hj_Int(16,0,fps);
		print();
		Camera_LeftPan(camera);
		Buffer_Refresh();
	
	
	}
}

